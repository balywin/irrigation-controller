// webserver_embedded.cpp
// Example to serve embedded static files from the generated `embedded_files.h` and
// provide JSON config GET/PUT endpoints that persist to LittleFS.

#include <Arduino.h>
#include <AsyncTCP.h>
#include <ESPAsyncWebServer.h>
#include <LittleFS.h>
#include "embedded_files.h" // generated by tools/embed_static.js
#include "fallback_page.h"
#include "main.h"
#include "schedule_cache.h"

// Call from your setup():
//   LittleFS.begin();
//   setupEmbeddedWebServer(server);

static String contentTypeFromPath(const String &path) {
  if (path.endsWith(".html")) return "text/html";
  if (path.endsWith(".js")) return "application/javascript";
  if (path.endsWith(".css")) return "text/css";
  if (path.endsWith(".json")) return "application/json";
  if (path.endsWith(".svg")) return "image/svg+xml";
  if (path.endsWith(".png")) return "image/png";
  if (path.endsWith(".jpg") || path.endsWith(".jpeg")) return "image/jpeg";
  return "application/octet-stream";
}

// Helper: send PROGMEM buffer using AsyncWebServerResponse from a request
static void sendEmbedded(AsyncWebServerRequest *request, const EmbeddedFile &f) {
  // Use non-deprecated beginResponse overload which accepts a content pointer.
  // The embedded data arrays are placed in flash; on ESP32 the pointer can be
  // passed directly.
  AsyncWebServerResponse *response = request->beginResponse(200, String(f.contentType), (const uint8_t*)f.data, f.size);
  if (f.gzip) {
    response->addHeader("Content-Encoding", "gzip");
  }
  // Add caching headers if you want
  response->addHeader("Cache-Control", "public, max-age=600");
  request->send(response);
}

// Look up embedded file by path (exact match)
static const EmbeddedFile* findEmbedded(const String &path) {
  for (size_t i = 0; i < embedded_files_count; ++i) {
    if (path.equals(embedded_files[i].url)) return &embedded_files[i];
  }
  return nullptr;
}

// Copy default config files (embedded) into LittleFS if they don't exist or version mismatch
static void copyDefaultsToFSIfNeeded() {
  // For each embedded file that lives under /config (URL prefix), ensure a file exists in LittleFS
  for (size_t i = 0; i < embedded_files_count; ++i) {
    const EmbeddedFile &f = embedded_files[i];
    String url = String(f.url);
    if (!url.startsWith("/config/")) continue;
    String fsPath = url; // write to same path in LittleFS
    if (!LittleFS.exists(fsPath)) {
      File file = LittleFS.open(fsPath, "w");
      if (file) {
        file.write(f.data, f.size);
        file.close();
        Serial.printf("Copied default config %s -> LittleFS\n", fsPath.c_str());
      } else {
        Serial.printf("Failed to open %s for writing\n", fsPath.c_str());
      }
    }
  }
}

void setupEmbeddedWebServer(AsyncWebServer &server) {
  // Ensure LittleFS is initialised. The project usually calls initFs() before this
  // function which mounts LittleFS with the desired options. Avoid unconditionally
  // calling LittleFS.begin() here to prevent conflicting mount parameters.
  // If LittleFS does not appear mounted, attempt a best-effort mount.
  if (LittleFS.totalBytes() != 0 || LittleFS.begin()) {
    copyDefaultsToFSIfNeeded();
  } else {
    Serial.println("LittleFS not mounted - config defaults won't be copied");
  }

  // Serve embedded files by exact path
  for (size_t i = 0; i < embedded_files_count; ++i) {
    const EmbeddedFile &f = embedded_files[i];
    String url = String(f.url);
    // capture f by value in lambda
    server.on(url.c_str(), HTTP_GET, [f](AsyncWebServerRequest *request){
      sendEmbedded(request, f);
    });
  }

  // GET a specific config (regex route: match /api/config/<name>) — must be registered
  // BEFORE the listing route, because ESPAsyncWebServer also matches /api/config as a
  // prefix of /api/config/<name>; first registered handler wins.
  server.on("^/api/config/.*$", HTTP_GET, [](AsyncWebServerRequest *request){
    String url = request->url();
    String name = url.substring(String("/api/config/").length());
    String fsPath = "/config/" + name;
    if (!LittleFS.exists(fsPath)) {
      // try to find embedded default
      String url = fsPath;
      const EmbeddedFile *ef = findEmbedded(url);
      if (ef) {
        sendEmbedded(request, *ef);
        return;
      }
      request->send(404, "text/plain", "Not found");
      return;
    }
    File f = LittleFS.open(fsPath, "r");
    if (!f) { request->send(500, "text/plain", "Failed to open"); return; }
    size_t len = f.size();
    std::unique_ptr<char[]> buf(new char[len+1]);
    f.readBytes(buf.get(), len);
    buf[len] = '\0';
    request->send(200, "application/json", buf.get());
  });

  // POST create/update a config: body contains JSON, path param is filename
  server.on("^/api/config/.*$", HTTP_POST, [](AsyncWebServerRequest *request){
    // this will be handled by onBody - send placeholder
    request->send(200, "text/plain", "OK");
  }, NULL, [](AsyncWebServerRequest *request, uint8_t *data, size_t len, size_t index, size_t total){
    String url = request->url();
    String name = url.substring(String("/api/config/").length());
    String fsPath = "/config/" + name;
    // append or write depending on index
    if (index == 0) {
      File f = LittleFS.open(fsPath, "w");
      if (!f) { Serial.printf("Failed to open %s for writing\n", fsPath.c_str()); }
      if (f) { f.write(data, len); f.close(); }
    } else {
      File f = LittleFS.open(fsPath, "a");
      if (!f) { Serial.printf("Failed to append %s\n", fsPath.c_str()); }
      if (f) { f.write(data, len); f.close(); }
    }
    if (index + len >= total && name == "schedule.json") {
      loadSchedule();
    }
  });

  // List all config files (registered AFTER per-file routes — prefix-matches
  // /api/config and would otherwise swallow /api/config/<name>)
  server.on("/api/config", HTTP_GET, [](AsyncWebServerRequest *request){
    String out = "[";
    File dir = LittleFS.open("/config");
    if (!dir) {
      request->send(200, "application/json", "[]");
      return;
    }
    bool first = true;
    File file = dir.openNextFile();
    while (file) {
      if (!first) out += ",";
      first = false;
      String name = String(file.name());
      int pos = name.lastIndexOf('/');
      String fname = (pos >= 0) ? name.substring(pos + 1) : name;
      out += '"'; out += fname; out += '"';
      file = dir.openNextFile();
    }
    out += "]";
    request->send(200, "application/json", out);
  });

  // Irrigation control API
  server.on("^/api/irrigation/status$", HTTP_GET, [](AsyncWebServerRequest *request){
    String json = String("{\"grass\":") + (isGrassIrrigating() ? "true" : "false") +
                  ",\"drip\":"          + (isDripIrrigating()  ? "true" : "false") + "}";
    request->send(200, "application/json", json);
  });

  server.on("^/api/irrigation/grass/start$", HTTP_POST, [](AsyncWebServerRequest *request){
    startGrassIrrigation();
    request->send(200, "application/json", "{\"ok\":true}");
  });

  server.on("^/api/irrigation/grass/stop$", HTTP_POST, [](AsyncWebServerRequest *request){
    stopGrassIrrigation();
    request->send(200, "application/json", "{\"ok\":true}");
  });

  server.on("^/api/irrigation/drip/start$", HTTP_POST, [](AsyncWebServerRequest *request){
    startDripIrrigation();
    request->send(200, "application/json", "{\"ok\":true}");
  });

  server.on("^/api/irrigation/drip/stop$", HTTP_POST, [](AsyncWebServerRequest *request){
    stopDripIrrigation();
    request->send(200, "application/json", "{\"ok\":true}");
  });

  // Not found handler: fallback to index.html for SPA routes
  server.onNotFound([](AsyncWebServerRequest *request){
    // If it's an API or filesystem route, return 404
    String uri = request->url();
    if (uri.startsWith("/api/") || uri.startsWith("/config/")) {
      request->send(404);
      return;
    }
    // Try embedded index.html first, then fallback recovery page
    const EmbeddedFile *ef = findEmbedded("/index.html");
    if (ef) {
      sendEmbedded(request, *ef);
      return;
    }
    // Try LittleFS index.html
    if (LittleFS.exists("/index.html")) {
      request->send(LittleFS, "/index.html", "text/html");
      return;
    }
    // Last resort: serve the embedded fallback/recovery page
    request->send(200, "text/html", FALLBACK_HTML);
  });
}
